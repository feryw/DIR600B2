## dir600b_v2.03/configs/Config.in
```kconfig
#
# main Config.in file for ELBOX configuration
#

mainmenu "ELBOX Configuration"

config ELBOX_HAVE_DOT_CONFIG
	bool
	default y

config ELBOX_FIRMWARE_VERSION
	string "Customized F/W version"
	default "N/A"

config ELBOX_FIRMWARE_REVISION
	string "Customized F/W revision"
	default "N/A"

comment "Device Configuration"
config ELBOX_FIRMWARE_SIGNATURE
	string 'Customized F/W signature'
	default "N/A"

comment "Programs Configuration"

source configs/progs.gpl/Config.in
source configs/progs.priv/Config.in

menu "Common library configuration"
config ELBOX_COMLIB_MEM_HELPER_DISABLE
	bool "Disable mem_helper"
	default y
	help
		The main purpose of the mem_helper module is for debuggin.
		Recommanded to disable mem_helper in the release version.
endmenu
```

## dir600b_v2.03/configs/progs.gpl/Config.in
```kconfig
#
# Config.in for progs.gpl
#
menu "GPL Programs"

comment "------------------------ Busybox ------------------------ ---"
source configs/progs.gpl/config.busybox
comment "------------------------ Programs ----------------------- ---"
source configs/progs.gpl/config.arptables
source configs/progs.gpl/config.bpalogin
source configs/progs.gpl/config.chillispot
source configs/progs.gpl/config.dibbler
source configs/progs.gpl/config.dhcpv6-lv
source configs/progs.gpl/config.dns
source configs/progs.gpl/config.hostapd
source configs/progs.gpl/config.httpd
source configs/progs.gpl/config.igmpproxy
source configs/progs.gpl/config.ippersonality
source configs/progs.gpl/config.iproute2
source configs/progs.gpl/config.ipt-string
source configs/progs.gpl/config.iptables
source configs/progs.gpl/config.itunes_server
source configs/progs.gpl/config.klogd
source configs/progs.gpl/config.lprng
source configs/progs.gpl/config.nsbbox
source configs/progs.gpl/config.openssh
source configs/progs.gpl/config.pppd
source configs/progs.gpl/config.pure_ftpd
source configs/progs.gpl/config.quota
source configs/progs.gpl/config.radvd
source configs/progs.gpl/config.samba
source configs/progs.gpl/config.snmp
source configs/progs.gpl/config.stunnel
source configs/progs.gpl/config.stupid_ftpd
source configs/progs.gpl/config.syslogd
source configs/progs.gpl/config.telnetd
source configs/progs.gpl/config.tinylogin
source configs/progs.gpl/config.tzdir
source configs/progs.gpl/config.udev
source configs/progs.gpl/config.udhcp
source configs/progs.gpl/config.upnpigd
source configs/progs.gpl/config.usb_mode_switch
source configs/progs.gpl/config.wakeonlan
source configs/progs.gpl/config.wide-dhcpv6
source configs/progs.gpl/config.wireless_tools
source configs/progs.gpl/config.xsupplicant
source configs/progs.gpl/config.zebra
source configs/progs.gpl/config.radiusclient
source configs/progs.gpl/config.ecmh
source configs/progs.gpl/config.iputils
comment "------------------------ Libraries ------------------------ ---"
source configs/progs.gpl/config.flex
source configs/progs.gpl/config.libnl
source configs/progs.gpl/config.libgsasl
source configs/progs.gpl/config.openssl
source configs/progs.gpl/config.libtorrent
source configs/progs.gpl/config.zlib
source configs/progs.gpl/config.email

endmenu
```

## dir600b_v2.03/configs/progs.priv/Config.in
```kconfig
#
# Config.in for progs.priv
#

menu "Private Programs (developed by AlphaNetworks)"

source configs/progs.priv/config.callmgr
source configs/progs.priv/config.xmldb
source configs/progs.priv/config.rgbin
source configs/progs.priv/config.alphaxgi
source configs/progs.priv/config.ipsec-pt
source configs/progs.priv/config.ifresetcnt
source configs/progs.priv/config.stun_nat
source configs/progs.priv/config.turbonat
source configs/progs.priv/config.bwc
source configs/progs.priv/config.flowmeter
source configs/progs.priv/config.appex
source configs/progs.priv/config.log
source configs/progs.priv/config.madwifi
source configs/progs.priv/config.art_ap83
source configs/progs.priv/config.madwifi_ap83
source configs/progs.priv/config.madwifi_cavium
source configs/progs.priv/config.madwifi_fusion_cavium
source configs/progs.priv/config.madwifi_cavium_fusion_seattle
source configs/progs.priv/config.ralink_wifi
source configs/progs.priv/config.ralink_iNIC
source configs/progs.priv/config.rt2860v2
source configs/progs.priv/config.rt2561
source configs/progs.priv/config.broadcom_wifi
source configs/progs.priv/config.rt3090
source configs/progs.priv/config.rt3883_3662
source configs/progs.priv/config.samsung_ezlink
source configs/progs.priv/config.upnpkits
source configs/progs.priv/config.neaps
source configs/progs.priv/config.apneap
source configs/progs.priv/config.igmp
source configs/progs.priv/config.igmpproxy
source configs/progs.priv/config.scheduled
source configs/progs.priv/config.common_scripts
source configs/progs.priv/config.others
source configs/progs.priv/config.alpha_hotplug
source configs/progs.priv/config.madwifi_dband
source configs/progs.priv/config.alpha_nls_drv
source configs/progs.priv/config.wpstools
source configs/progs.priv/config.wpa_supplicant
source configs/progs.priv/config.capwap
source configs/progs.priv/config.cli
source configs/progs.priv/config.wlxmlpatchv2
source configs/progs.priv/config.netbios
source configs/progs.priv/config.ethlink
source configs/progs.priv/config.sendmail
source configs/progs.priv/config.static_dhcp
source configs/progs.priv/config.servd
source configs/progs.priv/config.cgibin.aries
source configs/progs.priv/config.upnp_av_server
source configs/progs.priv/config.alpha_gd
source configs/progs.priv/config.cloned
source configs/progs.priv/config.logd
source configs/progs.priv/config.iodata_quickcopy
source configs/progs.priv/config.iodata_quickcopy_client
source configs/progs.priv/config.ddnsd
source configs/progs.priv/config.dhcpplus
source configs/progs.priv/config.starspeed
source configs/progs.priv/config.trap_monitor
source configs/progs.priv/config.autorekey
source configs/progs.priv/config.alpha_3gtool
source configs/progs.priv/config.webredirect
source configs/progs.priv/config.wfi_inv
source configs/progs.priv/config.igmp_2_6_27
source configs/progs.priv/config.usboverip
source configs/progs.priv/config.ralink_repeater
source configs/progs.priv/config.ralink_scan
source configs/progs.priv/config.llmnresp
source configs/progs.priv/config.wepclientinfopatch
source configs/progs.priv/config.madwifi_ar724x
source configs/progs.priv/config.updatewifistats
source configs/progs.priv/config.rtstad
source configs/progs.priv/config.atheros-hostapd-supplicant
endmenu
```

## dir600b_v2.03/kernels/rt305x/drivers/net/raeth/Kconfig
```kconfig
config RAETH
        tristate "Ralink GMAC"
        ---help---
          This driver supports Ralink gigabit ethernet family of
          adapters.

config RAETH_v2
		bool "Use Ralink GMAC driver from SDK3300"
		depends on !RAETH

config RAETH_v2_POWER_SAVING
		bool "Link down power saving support"
		depends on RAETH_v2

config RAETH_NAPI
        bool "Use Rx Polling (NAPI)"
        depends on RAETH

config RAETH_JUMBOFRAME
        bool "Jumbo Frame up to 4K bytes"
        depends on RAETH && !RALINK_RT3052

config RAETH_CHECKSUM_OFFLOAD
        bool "TCP/UDP/IP checksum offload"
	default y
        depends on RAETH_v2 && !RALINK_RT2880

config RAETH_QOS
        bool "QoS Feature"
        depends on RAETH && !RALINK_RT2880

config RAETH_GMAC2
        bool "GMAC2 Support"
        depends on RAETH && RALINK_RT2883

choice
        prompt "GMAC is connected to"
        depends on RAETH || RAETH_v2
        default IC+

config  RAETH_ROUTER
        bool "IC+"
        depends on !RALINK_RT3052

config  ICPLUS_PHY
        bool "100PHY"
        depends on !RALINK_RT3052

config  MAC_TO_MAC_MODE
        bool "VITESSE"
        depends on !RALINK_RT3052

config  RT_3052_ESW
        bool "RT3052 Embedded Switch"
	select LAN_WAN_SUPPORT
        depends on RALINK_RT3052

config RT_3052_ESW_PORT_STATUS_INT	
		bool "RT3052 ESW Port status change interrupt support"
		depends on RT_3052_ESW

config  GIGAPHY
        bool "MARVELL"
        depends on !RALINK_RT3052

endchoice

config  MAC_TO_GIGAPHY_MODE_ADDR
        hex "Phy Address"
	default 0x1F
        depends on GIGAPHY

config LAN_WAN_SUPPORT
        bool "LAN/WAN Partition"
        depends on RAETH_ROUTER || RT_3052_ESW

choice
        prompt "Board Layout Type"
        depends on LAN_WAN_SUPPORT
	default WAN_AT_P0

	config  WAN_AT_P4
	        bool "LLLL/W"
		
	config  WAN_AT_P0
	        bool "W/LLLL"
endchoice

config	ESW_DOUBLE_VLAN_TAG
	bool "Double VLAN Tag Support"
	depends on RT_3052_ESW

config RAETH_RT3052_P5
        bool "Port 5 Support"
        depends on (RAETH || RAETH_v2) && RALINK_RT3052
choice
        prompt "Target Mode"
        depends on RAETH_RT3052_P5
	default P5_RGMII_TO_MAC_MODE

	config P5_MAC_TO_PHY_MODE
		bool "Giga_Phy (RGMII)"
	config P5_RGMII_TO_MAC_MODE
		bool "Giga_SW/iNIC (RGMII)"
	config P5_MII_TO_MAC_MODE
		bool "External_CPU (MII_RvMII)"
	config P5_RMII_TO_MAC_MODE
		bool "External_CPU (RvMII_MII)"
endchoice


config RT3052_DISABLE_LANPORT
		bool "Diaable Lan port 1~4"
		depends on RALINK_RT3052

config RT_3052_ESW_IEEE8023_WORKAROUND
		bool "Workaround for IEEE 802.3 test"
		depends on RT_3052_ESW
```

## dir600b_v2.03/kernels/rt305x/drivers/net/wireless/rt2860v2_ap/Kconfig
```kconfig
config RT2860V2_AP
	tristate "Ralink RT2860 802.11n AP support - 2860v2, support both RBUS and PCI"
	depends on NET_RADIO

choice
	prompt "Bus Type"
	depends on RT2860V2_AP
	default RT2860V2_AP_RBUS

	config  RT2860V2_AP_RBUS
	bool "RBUS"

	config  RT2860V2_AP_RBUS_PCI
	bool "RBUS+PCI"
	depends on PCI
endchoice

config  RT2860V2_AP_2850
	bool "Dual Band"
	depends on RT2860V2_AP

config  RT2860V2_AP_LED
	bool "LED Support"
	depends on RT2860V2_AP

config  RT2860V2_AP_WSC
	bool "WSC (WiFi Simple Config)"
	depends on RT2860V2_AP

config  RT2860V2_AP_LLTD
	bool "LLTD (Link Layer Topology Discovery Protocol)"
	depends on RT2860V2_AP

config  RT2860V2_AP_WDS
	bool "WDS"
	depends on RT2860V2_AP

config  RT2860V2_AP_MBSS
	bool "MBSSID"
	depends on RT2860V2_AP

config  RT2860V2_AP_APCLI
	bool "AP-CLient Support"
	depends on RT2860V2_AP

config  RT2860V2_AP_IGMP_SNOOP
	bool "IGMP snooping"
	depends on RT2860V2_AP

config  RT2860V2_AP_NETIF_BLOCK
	bool "NETIF Block"
	depends on RT2860V2_AP

config  RT2860V2_AP_DFS
	bool "DFS"
	depends on RT2860V2_AP

config  RT2860V2_AP_CARRIER
	bool "Carrier Detect"
	depends on RT2860V2_AP

config  RT2860V2_AP_DLS
	bool "DLS ((Direct-Link Setup) Support"
	depends on RT2860V2_AP

config  RT2860V2_AP_IDS
	bool "IDS (Intrusion Detection System) Support"
	depends on RT2860V2_AP

config  CONFIG_RT2860V2_AP_MESH
	bool "MESH Support"
	depends on RT2860V2_AP
```

## dir600b_v2.03/kernels/rt305x/drivers/net/wireless/rt2860v2_sta/Kconfig
```kconfig
config RT2860V2_STA
	tristate "Ralink RT2860 802.11n STA support - 2860v2, support both RBUS and PCI"
	depends on NET_RADIO

choice
	prompt "Bus Type"
	depends on RT2860V2_STA
	default RT2860V2_STA_RBUS

	config  RT2860V2_STA_RBUS
	bool "RBUS"

	config  RT2860V2_STA_RBUS_PCI
	bool "RBUS+PCI"
	depends on PCI
endchoice

config  RT2860V2_STA_2850
	bool "Dual Bnad"
	depends on RT2860V2_STA

config  RT2860V2_STA_LED
	bool "LED Support"
	depends on RT2860V2_STA

config  RT2860V2_STA_WPA_SUPPLICANT
	bool "WPA Supplicant"
	depends on RT2860V2_STA

config  RT2860V2_STA_WSC
	bool "WSC (WiFi Simple Config)"
	depends on RT2860V2_STA

#config  RT2860V2_STA_DPB
#	bool "DPB Support"
#	depends on RT2860V2_STA

config  CONFIG_RT2860V2_STA_CARRIER
	bool "Carrier Sense Support"
	depends on RT2860V2_STA
```

## dir600b_v2.03/kernels/rt305x/net/bridge/Kconfig
```kconfig
#
# 802.1d Ethernet Bridging
#

config BRIDGE
	tristate "802.1d Ethernet Bridging"
	select LLC
	---help---
	  If you say Y here, then your Linux box will be able to act as an
	  Ethernet bridge, which means that the different Ethernet segments it
	  is connected to will appear as one Ethernet to the participants.
	  Several such bridges can work together to create even larger
	  networks of Ethernets using the IEEE 802.1 spanning tree algorithm.
	  As this is a standard, Linux bridges will cooperate properly with
	  other third party bridge products.

	  In order to use the Ethernet bridge, you'll need the bridge
	  configuration tools; see <file:Documentation/networking/bridge.txt>
	  for location. Please read the Bridge mini-HOWTO for more
	  information.

	  If you enable iptables support along with the bridge support then you
	  turn your bridge into a bridging IP firewall.
	  iptables will then see the IP packets being bridged, so you need to
	  take this into account when setting up your firewall rules.
	  Enabling arptables support when bridging will let arptables see
	  bridged ARP traffic in the arptables FORWARD chain.

	  To compile this code as a module, choose M here: the module
	  will be called bridge.

	  If unsure, say N.
config BRIDGE_FORWARD_CTRL
	bool "Forwarding Control"
	depends on BRIDGE
	---help---
	  This option allows you to enable/disable the forward function of the kernel
	  bridge module by proc_fs /proc/net/br_forward_br0.
	  The default status is 1, indicates bridge forward enable.

	  To disable the function just echo 0 to this node:
	  echo 0 > /proc/net/br_forward_br0

	  and echo 1 to re-enable it:
	  echo 1 > /proc/net/br_forward_br0
config BRIDGE_PORT_FORWARD
	bool "Port forwarding Control"
	depends on BRIDGE
	---help---

config BRIDGE_MULTICAST_BWCTRL
	bool "Multicast packet bandwidth control"
	depends on BRIDGE
	---help---

config BRIDGE_IGMPP_PROCFS
	bool "Bridge with IGMPProxy procfs support"
	depends on BRIDGE
	---help---
	  The original kernel bridge module will flooding multicast packet to each 
	  interface (port list), this kind of phenomenon will cause bandwidth of wireless 
	  interface(port) has to be fouled at basic rate and make other protocols/applications 
	  that use basic rate can't work fine.

	  If you say Y here,the bridge will transform multicast packet into unicast packet by
	  replace multicast MAC address with each member's MAC address.

config BRIDGE_IGMPP_PROCFS_DEBUG
	bool "Bridge with IGMPProxy procfs debugging"
	depends on BRIDGE_IGMPP_PROCFS
	---help---

config BRIDGE_IOAPNL
	bool "IO-Data AP Network Limitation"
	depends on BRIDGE
	---help---

config BRIDGE_MAT
	bool "MAC address translator"
	depends on BRIDGE
	default n
		---help---
		MAT for AP client.

config BRIDGE_MAC_CLONE
	bool "MAC address clone"
	depends on BRIDGE
	default n
		---help---
		MAC clone for AP client
```

## dir600b_v2.03/kernels/rt305x/ralink/Kconfig
```kconfig
menu "Ralink Module"

source "drivers/net/rt_rdm/Kconfig"
source "drivers/net/raeth/Kconfig"
source "drivers/net/wireless/rt2860v2_ap/Kconfig"
source "drivers/net/wireless/rt2860v2_sta/Kconfig"
#source "drivers/net/wireless/iNIC/Kconfig"
source "drivers/usb/dwc_otg/Kconfig"

#choice
#prompt "Ralink NAT Type"
	
#config  RA_NAT_NONE
#bool "None"
#config  RA_NAT_HW
#bool "Hardware"
#endchoice

#source "net/nat/hw_nat/Kconfig"

endmenu
```
